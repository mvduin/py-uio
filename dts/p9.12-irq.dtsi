#include "subarctic/pinctrl.h"
#include "bone/pins.h"
#include "irq.h"

&am33xx_pinmux {
	p9_12_irq_pin: p9.12-irq {
		pinctrl-single,pins = <
			PIN_GPIN_PULLUP( P9_12 )  // gpio 1.28
		>;
	};
};

/ {
	// no idea what a proper place would be to put it
	p9.12-irq {
		compatible = "uio";
		uio-alias = "p9.12-irq";

		pinctrl-names = "default";
		pinctrl-0 = <&p9_12_irq_pin>;

		interrupt-parent = <&gpio1>;
		interrupts = <28 IRQ_TYPE_LEVEL_LOW>;
	};
};
